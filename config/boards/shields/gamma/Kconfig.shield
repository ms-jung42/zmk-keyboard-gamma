## config/boards/shields/gamma/Kconfig.shield
```kconfig
config SHIELD_GAMMA_LEFT
    def_bool $(shields_list_contains,gamma_left)
config SHIELD_GAMMA_RIGHT
    def_bool $(shields_list_contains,gamma_right)
```
