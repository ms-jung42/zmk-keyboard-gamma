#include "gamma.dtsi" // Notice that the main dtsi files are included in the overlay.

&default_transform { // The matrix transform for this board is 6 columns over because the left half is 6 columns wide according to the matrix.
    col-offset = <7>;
};

&kscan0 {
     row-gpios
        = <&gpio1 7 (GPIO_ACTIVE_HIGH | GPIO_PULL_DOWN)> // Row E from the schematic file
        , <&gpio0 9 (GPIO_ACTIVE_HIGH | GPIO_PULL_DOWN)> // Row E from the schematic file
        , <&gpio0 2 (GPIO_ACTIVE_HIGH | GPIO_PULL_DOWN)> // Row A from the schematic file
        , <&gpio1 1  (GPIO_ACTIVE_HIGH | GPIO_PULL_DOWN)> // Row B from the schematic file
        , <&gpio1 6 (GPIO_ACTIVE_HIGH | GPIO_PULL_DOWN)> // Row C from the schematic file
        , <&gpio1 4 (GPIO_ACTIVE_HIGH | GPIO_PULL_DOWN)> // Row D from the schematic file
        , <&gpio0 11 (GPIO_ACTIVE_HIGH | GPIO_PULL_DOWN)> // Row E from the schematic file
        ;

col-gpios
        = <&gpio0 31 GPIO_ACTIVE_HIGH> // col1 in the schematic
        , <&gpio0 29 GPIO_ACTIVE_HIGH> // col1 in the schematic
        , <&gpio1 2 GPIO_ACTIVE_HIGH> // col2 in the schematic
        , <&gpio1 15 GPIO_ACTIVE_HIGH> // col4 in the schematic
        , <&gpio1 13 GPIO_ACTIVE_HIGH> // col5 in the schematic
        , <&gpio1 11 GPIO_ACTIVE_HIGH> // col6 in the schematic
        , <&gpio0 10 GPIO_ACTIVE_HIGH> // col6 in the schematic
        , <&gpio0 22 GPIO_ACTIVE_HIGH> // col3 in the schematic
        , <&gpio0 24 GPIO_ACTIVE_HIGH> // col3 in the schematic
        ;
};

&right_encoder {
    status = "okay";
};